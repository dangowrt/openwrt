// SPDX-License-Identifier: GPL-2.0-or-later OR MIT

#include "qca9558_mikrotik_routerboard-960.dtsi"

/ {
	compatible = "mikrotik,routerboard-960pgs", "qca,qca9558";
	model = "MikroTik RouterBOARD 960PGS";
};
